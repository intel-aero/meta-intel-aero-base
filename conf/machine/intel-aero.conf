## conf/machine/intel-aero.conf
```bitbake
#@TYPE: Machine
#@NAME: Intel Aero.

#@DESCRIPTION: Machine configuration for Intel Aero Platform.
#Based on intel-corei7-64

require conf/machine/intel-corei7-64.conf

PREFERRED_PROVIDER_virtual/kernel = "linux-yocto"
PREFERRED_VERSION_linux-yocto = "4.4%"

MACHINE_EXTRA_RDEPENDS += "kernel-firmware-shisp-2401a0-v21"
MACHINE_EXTRA_RDEPENDS += "spidev"
# backport-iwlwifi won't build with pyro, using in-tree driver for time being
# MACHINE_EXTRA_RDEPENDS += "backport-iwlwifi"
MACHINE_EXTRA_RDEPENDS += "linux-firmware-iwlwifi-8000c"

MACHINE_EXTRA_RRECOMMENDS += "aero-watchdog aero-utils"
MACHINE_EXTRA_RRECOMMENDS += "efibootmgr"

KERNEL_MODULE_AUTOLOAD += "spi_imu spi_fpga"

MACHINE_FEATURES_remove = "acpi"

# Grub config
EFI_PROVIDER = "grub-efi"
APPEND += "console=ttyS0,115200n8 console=tty1"
GRUB_TIMEOUT = "3"
LABELS_LIVE = "install boot"
SERIAL_CONSOLES = "115200;ttyS0"
```
